# cxl_subflit_sanitizer_enclave: IP-XACT component
VLNV spectralsystems.org:cxl_security:cxl_subflit_sanitizer_enclave:1.0.0

## Address spaces and blocks
BAR0_MMIO_128B.CSR_BLOCK: base 0x0, range 128, width 64

## Registers
Registers are 64-bit, access not given, no defined reset value unless marked. A register's access mark holds for its fields unless they carry their own. Offsets are from the block's base; lines under a group give offsets from that group; [hi:lo] are bit positions; {n}, {i} and the like mark numbered series; 'fields as' and 'values as' point back to an identical list; <NAME> marks a mode.

## BAR0_MMIO_128B.CSR_BLOCK
Base 0x00000000
0x00 CSR_0x00_COARSE_SPATIAL_MASK
0x08 CSR_0x08_COARSE_TEMPORAL_MASK
0x10 CSR_0x10_SHADOW_KEY_LO
0x18 CSR_0x18_SHADOW_KEY_HI
0x20 CSR_0x20_EPOCH_CTRL_STATUS
0x28 CSR_0x28_INGRESS_CRD_CNT
0x30 CSR_0x30_EGRESS_CRD_CNT
0x38 CSR_0x38_SANITIZED_SLOT_CNT
0x40 CSR_0x40_SELF_NAK_CNT
0x48 CSR_0x48_TAMPER_TRAP_CNT
0x50 CSR_0x50_RWD_FIFO_STATUS
0x58 CSR_0x58_CANONICAL_EGRESS
0x60 CSR_0x60_FINE_COHORT_MASK
0x68 CSR_0x68_FINE_TIMEWHEEL_MASK
0x70 CSR_0x70_SPID_LIVE_BITMAP
0x78 CSR_0x78_PREFIX_SUBMODE_DMA
