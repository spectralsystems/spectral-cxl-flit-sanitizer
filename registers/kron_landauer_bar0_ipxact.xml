# kron_landauer_cxl_flit_sanitizer: IP-XACT component
VLNV spectralsystems.org:enclave_ip:kron_landauer_cxl_flit_sanitizer:3.4.0

## Address spaces and blocks
BAR0_MMIO_CSR_MAP.CSR_BLOCK: base 0x0, range 0x100, width 64

## Registers
Registers are 64-bit, access not given, no defined reset value unless marked. A register's access mark holds for its fields unless they carry their own. Offsets are from the block's base; lines under a group give offsets from that group; [hi:lo] are bit positions; {n}, {i} and the like mark numbered series; 'fields as' and 'values as' point back to an identical list; <NAME> marks a mode.

## BAR0_MMIO_CSR_MAP.CSR_BLOCK
Base 0x00000000
0x00 CSR_CHORD_SPATIAL — Write-Once-Per-Reset Monotonic AND-Ratchet Spatial Capability Mask (Lean 4 Theorems 7, 10 & 14: reg_next = reg_curr & wdata)
0x08 CSR_CHORD_TEMPORAL — Write-Once-Per-Reset Monotonic AND-Ratchet Temporal Capability Mask (Lean 4 Theorems 4, 7, 10, 11 & 14)
0x10 CSR_EPOCH_KEY_BANK0 — Dual-Bank Shadow-Sheaf Affine Coset Key Bank 0
0x18 CSR_EPOCH_KEY_BANK1 — Dual-Bank Shadow-Sheaf Affine Coset Key Bank 1
0x20 CSR_IDE_KEY_STATUS — Native CXL IDE Key_Set_Select (K_Set_Go) Active Epoch Phase Indicator and Processed Flit Counter
0x28 CSR_SLOTS_SANITIZED_CNT — Count of violating 128-bit slots replaced in Stage 1/2 with deterministic CXL_NOP or zeroed on S2M_DRS
0x30 CSR_CREDITS_REFUNDED_CNT — Count of synthetic +CRD flow-control pulses returned to upstream switch port
0x38 CSR_LAST_VIOL_BITMAP — Most recent 4-bit per-slot coboundary defect violation bitmap
0x40 CSR_SELF_INFLICTED_NAKS — Count of link-layer Go-Back-N NAK replay storms caused by sanitization (Hardware Invariant: 0)
0x48 CSR_FM_ESCALATION_TRAPS — Software-non-resettable hardware trap counter for blocked Fabric Manager privilege escalation attempts (cleared exclusively on cold reset rst_n = 0)
0x50 CSR_RWD_ROLLOVER_CNT — Count of 64-byte M2S_RwD multi-slot data rollover transactions evaluated
0x58 CSR_EGRESS_CANON_DIGEST — Beta-eta normal canonical proof-carrying egress witness digest (Lean 4 Theorem 15: I = 0 bits)
